## firmware/sticks3/sdkconfig.defaults
```kconfig
# 目标芯片锁定 ESP32-S3（StickS3 = ESP32-S3-PICO-1-N8R8）
CONFIG_IDF_TARGET="esp32s3"

# 8MB Flash / 8MB Octal PSRAM
CONFIG_ESPTOOLPY_FLASHSIZE_8MB=y
CONFIG_SPIRAM=y
CONFIG_SPIRAM_MODE_OCT=y

# BLE：单连接、绑定、LE Secure Connections（M2-BLE线协议冻结.md §1）
CONFIG_BT_ENABLED=y
CONFIG_BT_NIMBLE_ENABLED=y
CONFIG_BT_NIMBLE_MAX_CONNECTIONS=1
CONFIG_BT_NIMBLE_NVS_PERSIST=y
CONFIG_BT_NIMBLE_SECURITY_ENABLE=y

# 控制台走 USB-Serial-JTAG（与烧录同口，日志可见）
CONFIG_ESP_CONSOLE_USB_SERIAL_JTAG=y
```
